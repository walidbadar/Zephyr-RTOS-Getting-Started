## button/boards/esp32_devkitc_wroom.conf
```kconfig
# Enable GPIO
CONFIG_GPIO=y

# Enable HEAP
CONFIG_HEAP_MEM_POOL_SIZE=98304

# Enable ESP32 WIFI
# CONFIG_WIFI_ESP32=y
# CONFIG_ESP32_WIFI_STA_AUTO_DHCPV4=y

# Use DHCP for IPv4
CONFIG_NET_DHCPV4=y
CONFIG_NET_MGMT=y
CONFIG_NET_MGMT_EVENT=y

# Or assign a static IP address (useful for testing)
# Following line must be enabled, otherwise WiFi connection fails with -1.
# CONFIG_NET_CONFIG_NEED_IPV4=y
# CONFIG_NET_CONFIG_MY_IPV4_ADDR="192.168.1.30"
# CONFIG_NET_CONFIG_MY_IPV4_GW="192.168.1.1"
```
